## arch/arm/mach-realtek/Kconfig
```kconfig
# SPDX-License-Identifier: GPL-2.0+
#
if ARCH_REALTEK

config SYS_SOC
	default "realtek"

config SYS_CONFIG_NAME
	default "rtl9617c"

source "arch/arm/mach-realtek/rtl9617c/Kconfig"

endif
```

## arch/arm/mach-realtek/rtl9617c/Kconfig
```kconfig
# SPDX-License-Identifier: GPL-2.0+
#
config SOC_RTL9617C
	bool
	select ARM64
	select BOARD_LATE_INIT

config TARGET_TIANYI_TYFZA1_2P5G
	bool "Tianyi TYFZA1 2.5G"
	select SOC_RTL9617C

config TARGET_TIANYI_TYFZA1_4GE
	bool "Tianyi TYFZA1 4GE"
	select SOC_RTL9617C

config TARGET_YOUHUA_PT1500_H10_CT_2P5G
	bool "Youhua PT1500-H10-CT 2.5G"
	select SOC_RTL9617C

config TARGET_YOUHUA_PT1570_H10_CT_4GE
	bool "Youhua PT1570-H10-CT 4GE"
	select SOC_RTL9617C

source "board/tianyi/tyfza1/Kconfig"
source "board/youhua/pt1500-h10-ct/Kconfig"
source "board/youhua/pt1570-h10-ct/Kconfig"
```

## board/realtek/Kconfig
```kconfig
# SPDX-License-Identifier: GPL-2.0+
#
config RTK_WEB_FAILSAFE
	bool "Web failsafe recovery panel"
	depends on NET_LWIP
	select CMD_HTTPD
	select CMD_UBI
```

## board/realtek/pt1500/Kconfig
```kconfig
# SPDX-License-Identifier: GPL-2.0+
if TARGET_PT1500_H10_2P5G
config SYS_BOARD
	default "pt1500"
config SYS_VENDOR
	default "realtek"
config SYS_SOC
	default "taurus"
config SYS_CONFIG_NAME
	default "pt1500"
endif
```

## board/realtek/tyfza1/Kconfig
```kconfig
# SPDX-License-Identifier: GPL-2.0+
if TARGET_TYFZA1_2P5G || TARGET_TYFZA1_4GE
config SYS_BOARD
	default "tyfza1"
config SYS_VENDOR
	default "realtek"
config SYS_SOC
	default "taurus"
config SYS_CONFIG_NAME
	default "tyfza1"
endif
```

## board/tianyi/tyfza1/Kconfig
```kconfig
# SPDX-License-Identifier: GPL-2.0+
if TARGET_TIANYI_TYFZA1_2P5G || TARGET_TIANYI_TYFZA1_4GE
config SYS_BOARD
	default "tyfza1"
config SYS_VENDOR
	default "tianyi"
endif
```

## board/yhup/pt1500_h10/Kconfig
```kconfig
# SPDX-License-Identifier: GPL-2.0+
if TARGET_YHUP_PT1500_H10_2P5G
config SYS_BOARD
	default "pt1500_h10"
config SYS_VENDOR
	default "yhup"
endif
```

## board/yhup/pt1570_h10/Kconfig
```kconfig
# SPDX-License-Identifier: GPL-2.0+
if TARGET_YHUP_PT1570_H10
config SYS_BOARD
	default "pt1570_h10"
config SYS_VENDOR
	default "yhup"
endif
```

## board/youhua/pt1570-h10-ct/Kconfig
```kconfig
# SPDX-License-Identifier: GPL-2.0+
if TARGET_YOUHUA_PT1570_H10_CT_2P5G
config SYS_BOARD
	default "pt1570-h10-ct"
config SYS_VENDOR
	default "youhua"
endif
```

## configs/pt1500_defconfig
```kconfig
CONFIG_ARM=y
CONFIG_COUNTER_FREQUENCY=25000000
CONFIG_POSITION_INDEPENDENT=y
CONFIG_TARGET_PT1500=y
CONFIG_TEXT_BASE=0x04000000
CONFIG_SYS_MALLOC_LEN=0x2000000
CONFIG_SYS_MALLOC_F_LEN=0x4000
CONFIG_ENV_SOURCE_FILE="pt1500"
CONFIG_NR_DRAM_BANKS=2
CONFIG_ENV_SIZE=0x40000
CONFIG_ENV_OFFSET=0x280000
CONFIG_DM_GPIO=y
CONFIG_DEFAULT_DEVICE_TREE="rtl9617c-pt1500"
CONFIG_SYS_LOAD_ADDR=0x10000000
CONFIG_ENV_OFFSET_REDUND=0x2C0000
CONFIG_IDENT_STRING=" PT1500"
CONFIG_LTO=y
CONFIG_FIT=y
CONFIG_FIT_VERBOSE=y
CONFIG_SUPPORT_RAW_INITRD=y
CONFIG_SYS_PBSIZE=1056
CONFIG_HUSH_PARSER=y
# CONFIG_SYS_LONGHELP is not set
CONFIG_SYS_PROMPT="PT1500# "
CONFIG_CMD_BOOTMENU=y
# CONFIG_CMD_ELF is not set
# CONFIG_CMD_UNLZ4 is not set
# CONFIG_CMD_UNZIP is not set
CONFIG_CMD_GPIO=y
# CONFIG_CMD_LOADS is not set
CONFIG_CMD_MTD=y
CONFIG_CMD_DHCP=y
CONFIG_CMD_PING=y
CONFIG_CMD_HTTPD=y
CONFIG_HTTPD_DHCP_SERVER=y
CONFIG_CMD_CACHE=y
CONFIG_CMD_HASH=y
CONFIG_CMD_SMC=y
CONFIG_CMD_UBI=y
CONFIG_CMD_UBI_RENAME=y
# CONFIG_CMD_UBIFS is not set
CONFIG_ENV_OVERWRITE=y
CONFIG_ENV_IS_IN_NAND=y
CONFIG_ENV_REDUNDANT=y
CONFIG_NET_LWIP=y
CONFIG_NET_RANDOM_ETHADDR=y
CONFIG_SYS_RX_ETH_BUFFER=8
CONFIG_BUTTON=y
CONFIG_BUTTON_GPIO=y
CONFIG_CORTINA_GPIO=y
CONFIG_LED=y
CONFIG_LED_GPIO=y
# CONFIG_MMC is not set
CONFIG_MTD=y
CONFIG_DM_MTD=y
CONFIG_MTD_RAW_NAND=y
CONFIG_CORTINA_SPI_NAND=y
CONFIG_MTD_UBI_FASTMAP=y
CONFIG_TAURUS_NI=y
CONFIG_PHY_REALTEK=y
CONFIG_DM_SERIAL=y
CONFIG_CORTINA_UART=y
CONFIG_LZMA_SIZE_OPTIMIZATION=y
```
