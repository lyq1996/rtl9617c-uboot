## board/youhua/pt1570-h10-cu/Kconfig
```kconfig
# SPDX-License-Identifier: GPL-2.0+
if TARGET_YOUHUA_PT1570_H10_CU_2P5G
config SYS_BOARD
	default "pt1570-h10-cu"
config SYS_VENDOR
	default "youhua"
endif
```

## board/youhua/pt1570-r10-cu/Kconfig
```kconfig
# SPDX-License-Identifier: GPL-2.0+
if TARGET_YOUHUA_PT1570_R10_CU_4GE
config SYS_BOARD
	default "pt1570-r10-cu"
config SYS_VENDOR
	default "youhua"
endif
```

## board/youhua/pt1570-r10/Kconfig
```kconfig
# SPDX-License-Identifier: GPL-2.0+
if TARGET_YOUHUA_PT1570_R10
config SYS_BOARD
	default "pt1570-r10"
config SYS_VENDOR
	default "youhua"
endif
```
